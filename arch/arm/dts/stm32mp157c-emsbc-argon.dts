// SPDX-License-Identifier: (GPL-2.0+ OR BSD-3-Clause)
/*
 * Copyright (C) emtrion GmbH 2021 - All Rights Reserved
 */

/dts-v1/;

#include "stm32mp157c-emstamp-argon.dtsi"
#include <dt-bindings/rtc/rtc-stm32.h>

/ {
	model = "emtrion emSBC-Argon";
	compatible = "emtrion,stm32mp157c-emsbc-argon", "st,stm32mp157";

	emmc_pwrseq: emmc-pwrseq {
		compatible = "mmc-pwrseq-simple";
		reset-gpios = <&gpiof 14 GPIO_ACTIVE_LOW>;
	};
};

&sdmmc2 {
	arm,primecell-periphid = <0x10153180>;
	pinctrl-names = "default", "opendrain", "sleep";
	pinctrl-0 = <&sdmmc2_b4_pins_b>;
	pinctrl-1 = <&sdmmc2_b4_od_pins_b>;
	pinctrl-2 = <&sdmmc2_b4_sleep_pins_a>;
	non-removable;
	st,neg-edge;
	bus-width = <4>;
	vmmc-supply = <&v3v3>;
	vqmmc-supply = <&vdd>;
	keep-power-in-suspend;
	no-sd;
	no-sdio;
	mmc-ddr-3_3v;
	status = "okay";
};
